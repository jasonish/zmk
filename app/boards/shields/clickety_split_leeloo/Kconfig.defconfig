## app/boards/shields/clickety_split_leeloo/Kconfig.defconfig
```kconfig
# Copyright (c) 2024 The ZMK Contributors
# SPDX-License-Identifier: MIT

if SHIELD_LEELOO_REV3_LEFT

config ZMK_KEYBOARD_NAME
    default "Leeloo v2.1"

endif

if SHIELD_LEELOO_REV2_LEFT

config ZMK_KEYBOARD_NAME
    default "Leeloo v2.0"

endif

if SHIELD_LEELOO_LEFT

config ZMK_KEYBOARD_NAME
    default "Leeloo v1.1"

endif

if SHIELD_LEELOO_REV3_LEFT || SHIELD_LEELOO_REV3_RIGHT

config SHIELD_LEELOO_PM
    bool "ZMK Leeloo v2.1 Automatic Power Management"
    default y
    select ZMK_POWER_DOMAINS
    select ZMK_POWER_DOMAINS_DYNAMIC_DEFAULT
    select PM_DEVICE
    select PM_DEVICE_POWER_DOMAIN
    select PM_DEVICE_RUNTIME
    select POWER_DOMAIN
    select POWER_DOMAIN_GPIO

endif

if SHIELD_LEELOO

config ZMK_SPLIT
    default y

if ZMK_DISPLAY

config I2C
    default y

config SSD1306
    default y
endif # ZMK_DISPLAY

if LVGL

config LV_Z_VDB_SIZE
    default 64

config LV_DPI_DEF
    default 148

config LV_Z_BITS_PER_PIXEL
    default 1

choice LV_COLOR_DEPTH
    default LV_COLOR_DEPTH_1
endchoice

endif # LVGL

endif # SHIELD_LEELOO
```

## app/boards/shields/clickety_split_leeloo/Kconfig.shield
```kconfig
# Copyright (c) 2024 The ZMK Contributors
# SPDX-License-Identifier: MIT

config SHIELD_LEELOO
    bool

config SHIELD_LEELOO_LEFT
    def_bool $(shields_list_contains,leeloo_left)
    select SHIELD_LEELOO
    select ZMK_SPLIT
    select ZMK_SPLIT_ROLE_CENTRAL

config SHIELD_LEELOO_RIGHT
    def_bool $(shields_list_contains,leeloo_right)
    select SHIELD_LEELOO
    select ZMK_SPLIT

config SHIELD_LEELOO_REV2_LEFT
    def_bool $(shields_list_contains,leeloo_rev2_left)
    select SHIELD_LEELOO
    select ZMK_SPLIT
    select ZMK_SPLIT_ROLE_CENTRAL

config SHIELD_LEELOO_REV2_RIGHT
    def_bool $(shields_list_contains,leeloo_rev2_right)
    select SHIELD_LEELOO
    select ZMK_SPLIT

config SHIELD_LEELOO_REV3_LEFT
    def_bool $(shields_list_contains,leeloo_rev3_left)
    select SHIELD_LEELOO
    select ZMK_SPLIT
    select ZMK_SPLIT_ROLE_CENTRAL

config SHIELD_LEELOO_REV3_RIGHT
    def_bool $(shields_list_contains,leeloo_rev3_right)
    select SHIELD_LEELOO
    select ZMK_SPLIT
```

## app/boards/shields/clickety_split_leeloo_micro/Kconfig.defconfig
```kconfig
# Copyright (c) 2024 The ZMK Contributors
# SPDX-License-Identifier: MIT

if SHIELD_LEELOO_MICRO_REV2_LEFT

config ZMK_KEYBOARD_NAME
    default "Leeloo-Micro 1.1"

endif

if SHIELD_LEELOO_MICRO_LEFT

config ZMK_KEYBOARD_NAME
    default "Leeloo-Micro"

endif

if SHIELD_LEELOO_MICRO_REV2_LEFT || SHIELD_LEELOO_MICRO_REV2_RIGHT

config SHIELD_LEELOO_MICRO_PM
    bool "ZMK Leeloo-Micro v1.1 Automatic Power Management"
    default y
    select ZMK_POWER_DOMAINS
    select ZMK_POWER_DOMAINS_DYNAMIC_DEFAULT
    select PM_DEVICE
    select PM_DEVICE_POWER_DOMAIN
    select PM_DEVICE_RUNTIME
    select POWER_DOMAIN
    select POWER_DOMAIN_GPIO

endif

if SHIELD_LEELOO_MICRO

config ZMK_SPLIT
    default y

if ZMK_DISPLAY

config I2C
    default y

config SSD1306
    default y
endif # ZMK_DISPLAY

if LVGL

config LV_Z_VDB_SIZE
    default 64

config LV_DPI_DEF
    default 148

config LV_Z_BITS_PER_PIXEL
    default 1

choice LV_COLOR_DEPTH
    default LV_COLOR_DEPTH_1
endchoice

endif # LVGL

endif
```

## app/boards/shields/clickety_split_leeloo_micro/Kconfig.shield
```kconfig
# Copyright (c) 2024 The ZMK Contributors
# SPDX-License-Identifier: MIT

config SHIELD_LEELOO_MICRO
    bool

config SHIELD_LEELOO_MICRO_LEFT
    def_bool $(shields_list_contains,leeloo_micro_left)
    select SHIELD_LEELOO_MICRO
    select ZMK_SPLIT
    select ZMK_SPLIT_ROLE_CENTRAL

config SHIELD_LEELOO_MICRO_RIGHT
    def_bool $(shields_list_contains,leeloo_micro_right)
    select SHIELD_LEELOO_MICRO
    select ZMK_SPLIT

config SHIELD_LEELOO_MICRO_REV2_LEFT
    def_bool $(shields_list_contains,leeloo_micro_rev2_left)
    select SHIELD_LEELOO_MICRO
    select ZMK_SPLIT
    select ZMK_SPLIT_ROLE_CENTRAL

config SHIELD_LEELOO_MICRO_REV2_RIGHT
    def_bool $(shields_list_contains,leeloo_micro_rev2_right)
    select SHIELD_LEELOO_MICRO
    select ZMK_SPLIT
```

## app/boards/shields/clickety_split_mnml/Kconfig.defconfig
```kconfig
# Copyright (c) 2024 The ZMK Contributors
# SPDX-License-Identifier: MIT

if SHIELD_CLICKETY_SPLIT_MNML_LEFT

config ZMK_KEYBOARD_NAME
    default "MNML v1.13"

endif

if SHIELD_CLICKETY_SPLIT_MNML_LEFT || SHIELD_CLICKETY_SPLIT_MNML_RIGHT

config SHIELD_CLICKETY_SPLIT_MNML_PM
    bool "ZMK MNML v1.13 Automatic Power Management"
    default y
    select ZMK_POWER_DOMAINS
    select ZMK_POWER_DOMAINS_DYNAMIC_DEFAULT
    select PM_DEVICE
    select PM_DEVICE_POWER_DOMAIN
    select PM_DEVICE_RUNTIME
    select POWER_DOMAIN
    select POWER_DOMAIN_GPIO

endif
```

## app/boards/shields/clickety_split_mnml/Kconfig.shield
```kconfig
# Copyright (c) 2024 The ZMK Contributors
# SPDX-License-Identifier: MIT

config SHIELD_CLICKETY_SPLIT_MNML
    bool

config SHIELD_CLICKETY_SPLIT_MNML_LEFT
    def_bool $(shields_list_contains,clickety_split_mnml_left)
    select SHIELD_CLICKETY_SPLIT_MNML
    select ZMK_SPLIT
    select ZMK_SPLIT_ROLE_CENTRAL

config SHIELD_CLICKETY_SPLIT_MNML_RIGHT
    def_bool $(shields_list_contains,clickety_split_mnml_right)
    select SHIELD_CLICKETY_SPLIT_MNML
    select ZMK_SPLIT
```
